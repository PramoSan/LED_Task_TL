/**
 * @cliArgs --board "/ti/boards/CC1352R1_LAUNCHXL" --rtos "tirtos" --product "simplelink_cc13xx_cc26xx_sdk@5.30.01.01"
 * @versions {"tool":"1.10.0+2163"}
 */

/**
 * Import the modules used in this configuration.
 */
const DMA   = scripting.addModule("/ti/drivers/DMA");
const GPIO  = scripting.addModule("/ti/drivers/GPIO");
const GPIO1 = GPIO.addInstance();
const GPIO4 = GPIO.addInstance();
const PWM   = scripting.addModule("/ti/drivers/PWM", {}, false);
const PWM1  = PWM.addInstance();
const Power = scripting.addModule("/ti/drivers/Power");
const LED   = scripting.addModule("/ti/drivers/apps/LED", {}, false);
const LED1  = LED.addInstance();

/**
 * Write custom configuration values to the imported modules.
 */
GPIO1.$name     = "CONFIG_GPIO_BUTTON_0";
GPIO1.$hardware = system.deviceData.board.components["BTN-2"];

GPIO4.$hardware = system.deviceData.board.components["BTN-1"];
GPIO4.$name     = "CONFIG_GPIO_BUTTON_1";

PWM1.$name                            = "CONFIG_PWM_0";
PWM1.$hardware                        = system.deviceData.board.components.LED_RED;
PWM1.timerObject.$name                = "CONFIG_GPTIMER_0";
PWM1.timerObject.timer.$assign        = "GPTM1";
PWM1.timerObject.timer.pwmPin.$assign = "boosterpack.39";

const CCFG              = scripting.addModule("/ti/devices/CCFG", {}, false);
CCFG.ccfgTemplate.$name = "ti_devices_CCFGTemplate0";

LED1.$name          = "CONFIG_LED_0";
LED1.$hardware      = system.deviceData.board.components.LED_GREEN;
LED1.ledPin.$assign = "boosterpack.40";
LED1.gpioPin.$name  = "CONFIG_GPIO_LED_0";

/**
 * Pinmux solution for unlocked pins/peripherals. This ensures that minor changes to the automatic solver in a future
 * version of the tool will not impact the pinmux you originally saw.  These lines can be completely deleted in order to
 * re-solve from scratch.
 */
GPIO1.gpioPin.$suggestSolution = "boosterpack.12";
GPIO4.gpioPin.$suggestSolution = "boosterpack.13";
